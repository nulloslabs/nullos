## kernel/Kconfig
```kconfig
mainmenu "Nullkrnl Configuration"

menu "General Options"
config DEBUG
	bool "Enable debug info"
	default n
	help
		Enables debug info for the kernel binary and it's libraries.
		This also skips stripping.

endmenu

source "main/Kconfig"
source "io/Kconfig"
source "mm/Kconfig"
source "syscalls/Kconfig"
```

## kernel/io/Kconfig
```kconfig
menu "Disk Drivers"
menuconfig IDE
	bool "IDE"
	default y
	help
		Enables driver for IDE disk controller.

config ATAPI
	bool "ATAPI"
	default y
	depends on IDE
	help
		Enables driver for ATAPI drives.
		Used for CD/DVD's.

config PATA
	bool "PATA"
	default y
	depends on IDE
	help
		Enables driver for PATA drives.
		Used for old HDD's.

menuconfig AHCI
	bool "AHCI"
	default y
	help
		Enables driver for AHCI disk controller.

config SATA
	bool "SATA"
	default y
	depends on AHCI
	help
		Enables driver for SATA drives.
		Used for newer HDD's and SSD's.

menu "Partition Tables"
config MBR
	bool "MBR"
	default y
	help
		Enables driver for MBR partition tables.
		Used in old legacy BIOS systems.

config GPT
	bool "GPT"
	default y
	help
		Enables driver for GPT partition tables.
		Used in modern UEFI systems.

endmenu
endmenu

menu "Filesystems"
config VFAT
	bool "FAT16/32"
	default y
	help
		Enables driver for FAT16/32 formatted disks.
		Currently read-only.

config EXT4
	bool "ext2/3/4"
	default y
	help
		Enables driver for ext2/3/4 formatted disks.
		Currently read-only.

config ISO9660
	bool "ISO9660"
	default y
	help
		Enables driver for ISO9660 formatted CD/DVD's.

endmenu

menu "Device Drivers"
menu "Sound Cards"
config AC97
	bool "AC'97"
	default y
	help
		Enables driver for AC'97 sound card.

endmenu

menu "Graphics Cards"
config BGA
	bool "BGA"
	default y
	help
		Enables driver for BGA graphics card.

config SVGA_II
	bool "SVGA II"
	default y
	help
		Enables driver for SVGA II graphics card.

config VIRTIO_GPU
	bool "virtio-gpu"
	default y
	help
		Enables driver for virtio-gpu graphics card.

endmenu
menu "NICs"
config E1000
	bool "E1000"
	default y
	help
		Enables driver for E1000 NIC.

config RTL8139
	bool "RTL8139"
	default y
	help
		Enables driver for RTL8139 NIC.

endmenu
menu "USB"
config UHCI
	bool "UHCI"
	default y
	help
		Enables driver for UHCI USB controllers.

config OHCI
	bool "OHCI"
	default y
	help
		Enables driver for OHCI USB controllers.

menu "USB Devices"
config USB_KEYBOARD
	bool "USB keyboards"
	default y
	depends on UHCI || OHCI
	help
		Enables driver for USB keyboards.

endmenu
endmenu
endmenu
```

## kernel/main/Kconfig
```kconfig
menu "Processor Features"
config MAX_CPUS
	int "Maximum number of CPUs (1-512)"
	range 1 512
	default 64
	help
		Amount of CPUs that the kernel allows.

endmenu

menu "Timers"
choice
	prompt "Timer frequency"
    default HZ_250
	help
		Sets the timer frequency of the PIT and APIC timers.

config HZ_100
	bool "100 Hz"
	help
		Sets the timer frequency to 100 Hz.

config HZ_250
	bool "250 Hz"
	help
		Sets the timer frequency to 250 Hz.

config HZ_1000
	bool "1000 Hz"
	help
		Sets the timer frequency to 1000 Hz.

endchoice
config HZ
	int
	default 100 if HZ_100
	default 250 if HZ_250
	default 1000 if HZ_1000

endmenu
```

## kernel/mm/Kconfig
```kconfig
menu "Memory Management"
config OOM_KILLER
    bool "Out of memory killer"
    default y
    help
		Enables the out of memory killer.
		Used when the kernel runs out of memory, kills a process to free up memory.

endmenu
```
